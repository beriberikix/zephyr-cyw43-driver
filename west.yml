## west.yml
```yaml
# Copyright (c) 2023 Nordic Beechwoods Software, Inc.
# SPDX-License-Identifier: Apache-2.0

manifest:
  #self:
  #  west-commands: scripts/west-commands.yml
  defaults:
    remote: zephyrproject-rtos
    
  remotes:
    - name: zephyrproject-rtos
      url-base: https://github.com/zephyrproject-rtos

  projects:
    - name: zephyr
      remote: zephyrproject-rtos
      revision: 44af4534166bad6cec2f5a6eb226021260b9c49d
      import:
        # By using name-allowlist we can clone only the modules that are
        # strictly needed by the application.
        name-allowlist:
          - cmsis_6      # required by the ARM port
          - hal_rpi_pico
          - mbedtls
          - tf-psa-crypto  # required by mbedtls 4.x (PSA crypto backend)
          - hal_infineon
```
